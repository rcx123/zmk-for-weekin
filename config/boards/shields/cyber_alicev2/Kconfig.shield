## config/boards/shields/cyber_alicev2/Kconfig.shield
```kconfig
# Copyright (c) 2020 The ZMK Contributors
# SPDX-License-Identifier: MIT

config SHIELD_CYBER_ALICE_V2
    def_bool $(shields_list_contains,Cyber_Alice_v2)
```
